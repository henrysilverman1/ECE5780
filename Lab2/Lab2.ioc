# file: Lab2.ioc
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Mcu.Family=STM32F0
Mcu.Name=STM32F072R(8-B)Tx
Mcu.Package=LQFP64
ProjectManager.HeapSize=0x200
ProjectManager.StackSize=0x400
ProjectManager.TargetToolchain=MDK-ARM V5.32
board=custom

// file: Core/Src/main.c
/* USER CODE BEGIN Header */
/**
  ******************************************************************************
  * @file           : main.c
  * @brief          : Main program body
  ******************************************************************************
  * @attention
  *
  * Copyright (c) 2024 STMicroelectronics.
  * All rights reserved.
  *
  * This software is licensed under terms that can be found in the LICENSE file
  * in the root directory of this software component.
  * If no LICENSE file comes with this software, it is provided AS-IS.
  *
  ******************************************************************************
  */
/* USER CODE END Header */
#include "main.h"

/* USER CODE BEGIN PV */
volatile int exti0I;
/* USER CODE END PV */

void SystemClock_Config(void);

int main(void)
{
		//Clock enables
		RCC->AHBENR |= RCC_AHBENR_GPIOCEN; // Enable peripheral clock to GPIOC
		RCC->APB2ENR |= RCC_APB2ENR_SYSCFGCOMPEN; // Enable peripheral clock to SYSCONFIG

		//Create handler

  /* MCU Configuration--------------------------------------------------------*/

  /* Reset of all peripherals, Initializes the Flash interface and the Systick. */
  HAL_Init();

  /* Configure the system clock */
  SystemClock_Config();

  /* Initialize all configured peripherals */
  /* USER CODE BEGIN 2 */
	//LED config register
		GPIOC->MODER |= ((1 <<	12) | (1 <<	14) | (1 <<	16) | (1 <<	18)); //Setting second MODER bits to 1 for general-purpose output mode for PC6 and PC7
		GPIOC->MODER &= ~((1 <<	13) | (1 <<	15) | (1 <<	17) | (1 <<	19)); // Setting first MODER bits to 0 general-purpose output mode for PC6 and PC7
		GPIOC->OTYPER &= ~((1 << 6) | (1 << 7)| (1 << 8) | (1 << 9)); //Setting OTYPER bits to 0 for output push-pull
		GPIOC->OSPEEDR &= ~((1 <<	12) | (1 <<	14) | (1 <<	16) | (1 <<	18)); //Setting second OSPEEDR bits to 0 for low speed
		GPIOC->PUPDR &= ~((1 <<	12) | (1 <<	13) | (1 <<	14) | (1 <<	15) | (1 <<	16) | (1 <<	17) | (1 <<	18) | (1 <<	19)); //Setting both PUPDR bits 0 for no pull-up, pull-down
		GPIOC->ODR &= ~((1 << 6) | (1 << 7) | (1 << 8)); //Set blue, red, and green LED's low
		GPIOC->ODR |= ((1 << 9)); //Set Green LED high

		//Button config register
		GPIOA->MODER &= ~((1 << 0) | (1 << 1));
		GPIOA->OSPEEDR &= ~((1 << 0));
		GPIOA->PUPDR |= (1 << 1);
		GPIOA->PUPDR &= ~((1 << 0));

		//Syscfg pin set
		SYSCFG->EXTICR[0] &= ~(0xb01111); //Selects PA0 for EXTI0

		//EXTI Congig
		EXTI->IMR |= (1<<0); //Unmasks interrupt request from line 0
		EXTI->RTSR |= (1<<0); //Rising edge trigger on line 0

		//Enable EXTI Interrupt
		NVIC_EnableIRQ(EXTI0_1_IRQn);
		//Set priority of EXTI Interrupt
		NVIC_SetPriority(EXTI0_1_IRQn, 2);
		//Set priority of SysTick Interrupt
		NVIC_SetPriority(SysTick_IRQn , 3);
  /* USER CODE END 2 */

  /* Infinite loop */
  /* USER CODE BEGIN WHILE */
  while (1)
  {
		// Toggle PC6
    GPIOC->ODR ^= (1 << 6);
		HAL_Delay(400); // Delay 400ms
    /* USER CODE END WHILE */

  }
}

void SystemClock_Config(void)
{
  RCC_OscInitTypeDef RCC_OscInitStruct = {0};
  RCC_ClkInitTypeDef RCC_ClkInitStruct = {0};

  /** Initializes the RCC Oscillators according to the specified parameters
  * in the RCC_OscInitTypeDef structure.
  */
  RCC_OscInitStruct.OscillatorType = RCC_OSCILLATORTYPE_HSI;
  RCC_OscInitStruct.HSIState = RCC_HSI_ON;
  RCC_OscInitStruct.HSICalibrationValue = RCC_HSICALIBRATION_DEFAULT;
  RCC_OscInitStruct.PLL.PLLState = RCC_PLL_NONE;
  if (HAL_RCC_OscConfig(&RCC_OscInitStruct) != HAL_OK)
  {
    Error_Handler();
  }

  /** Initializes the CPU, AHB and APB buses clocks
  */
  RCC_ClkInitStruct.ClockType = RCC_CLOCKTYPE_HCLK|RCC_CLOCKTYPE_SYSCLK
                              |RCC_CLOCKTYPE_PCLK1;
  RCC_ClkInitStruct.SYSCLKSource = RCC_SYSCLKSOURCE_HSI;
  RCC_ClkInitStruct.AHBCLKDivider = RCC_SYSCLK_DIV1;
  RCC_ClkInitStruct.APB1CLKDivider = RCC_HCLK_DIV1;

  if (HAL_RCC_ClockConfig(&RCC_ClkInitStruct, FLASH_LATENCY_0) != HAL_OK)
  {
    Error_Handler();
  }
}

void Error_Handler(void)
{
  __disable_irq();
  while (1)
  {
  }
}

void EXTI0_1_IRQHandler(void)
{
	// Toggle PC8
  GPIOC->ODR ^= (1 << 8);
	// Toggle PC9
  GPIOC->ODR ^= (1 << 9);
	exti0I = 0;
	while(exti0I<1500000)
	{
		exti0I ++;
	}

	// Toggle PC8
  GPIOC->ODR ^= (1 << 8);
	// Toggle PC9
  GPIOC->ODR ^= (1 << 9);

  /* USER CODE END SysTick_IRQn 0 */

	//Set flag that event occured
	EXTI->PR |= (1 << 0);
}
